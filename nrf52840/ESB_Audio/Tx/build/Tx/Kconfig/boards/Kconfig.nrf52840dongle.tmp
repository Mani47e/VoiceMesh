## nrf52840/ESB_Audio/Tx/build/Tx/Kconfig/boards/Kconfig.nrf52840dongle.tmp
```kconfig
# Load board Kconfig descriptions.
osource "/opt/nordic/ncs/v3.4.0/zephyr/boards/nordic/nrf52840dongle/Kconfig.nrf52840dongle"
```

## nrf52840/i2s_test/build/Kconfig/boards/Kconfig.defconfig
```kconfig
# Load Zephyr board defconfig descriptions.
osource "/opt/nordic/ncs/v3.4.0/zephyr/boards/nordic/nrf52840dongle/Kconfig.defconfig"
```

## nrf52840/i2s_test/build/Kconfig/boards/Kconfig.sysbuild
```kconfig
# Load Sysbuild board Kconfig descriptions.
osource "/opt/nordic/ncs/v3.4.0/zephyr/boards/nordic/nrf52840dongle/Kconfig.sysbuild"
```
