## nrf52840/i2s_test/build/Kconfig/arch/Kconfig
```kconfig
# Load Zephyr Arch Kconfig descriptions.
osource "/Users/mani/zephyrproject/zephyr/arch/rx/Kconfig"
osource "/Users/mani/zephyrproject/zephyr/arch/x86/Kconfig"
osource "/Users/mani/zephyrproject/zephyr/arch/xtensa/Kconfig"
osource "/Users/mani/zephyrproject/zephyr/arch/sparc/Kconfig"
osource "/Users/mani/zephyrproject/zephyr/arch/riscv/Kconfig"
osource "/Users/mani/zephyrproject/zephyr/arch/posix/Kconfig"
osource "/Users/mani/zephyrproject/zephyr/arch/openrisc/Kconfig"
osource "/Users/mani/zephyrproject/zephyr/arch/mips/Kconfig"
osource "/Users/mani/zephyrproject/zephyr/arch/arm64/Kconfig"
osource "/Users/mani/zephyrproject/zephyr/arch/arm/Kconfig"
osource "/Users/mani/zephyrproject/zephyr/arch/arc/Kconfig"
```

## nrf52840/i2s_test/build/Kconfig/soc/Kconfig
```kconfig
# Load Zephyr SoC Kconfig descriptions.
osource "/Users/mani/zephyrproject/zephyr/soc/xlnx/zynqmp/Kconfig"
osource "/Users/mani/zephyrproject/zephyr/soc/xlnx/zynq7000/Kconfig"
osource "/Users/mani/zephyrproject/zephyr/soc/xlnx/versalnet/Kconfig"
osource "/Users/mani/zephyrproject/zephyr/soc/xlnx/versal2/Kconfig"
osource "/Users/mani/zephyrproject/zephyr/soc/xlnx/versal/Kconfig"
osource "/Users/mani/zephyrproject/zephyr/soc/xen/Kconfig"
osource "/Users/mani/zephyrproject/zephyr/soc/wch/ch32v/Kconfig"
osource "/Users/mani/zephyrproject/zephyr/soc/ti/simplelink/Kconfig"
osource "/Users/mani/zephyrproject/zephyr/soc/ti/mspm0/Kconfig"
osource "/Users/mani/zephyrproject/zephyr/soc/ti/lm3s6965/Kconfig"
osource "/Users/mani/zephyrproject/zephyr/soc/ti/k3/Kconfig"
osource "/Users/mani/zephyrproject/zephyr/soc/telink/tlsr/Kconfig"
osource "/Users/mani/zephyrproject/zephyr/soc/syna/sr100/Kconfig"
osource "/Users/mani/zephyrproject/zephyr/soc/starfive/jh71xx/Kconfig"
osource "/Users/mani/zephyrproject/zephyr/soc/st/stm32/Kconfig"
osource "/Users/mani/zephyrproject/zephyr/soc/snps/qemu_arc/Kconfig"
osource "/Users/mani/zephyrproject/zephyr/soc/snps/nsim/arc_v/Kconfig"
osource "/Users/mani/zephyrproject/zephyr/soc/snps/nsim/arc_classic/Kconfig"
osource "/Users/mani/zephyrproject/zephyr/soc/snps/hsdk4xd/Kconfig"
osource "/Users/mani/zephyrproject/zephyr/soc/snps/hsdk/Kconfig"
osource "/Users/mani/zephyrproject/zephyr/soc/snps/emsk/Kconfig"
osource "/Users/mani/zephyrproject/zephyr/soc/snps/emsdp/Kconfig"
osource "/Users/mani/zephyrproject/zephyr/soc/snps/arc_iot/Kconfig"
osource "/Users/mani/zephyrproject/zephyr/soc/silabs/Kconfig"
osource "/Users/mani/zephyrproject/zephyr/soc/sifli/sf32/Kconfig"
osource "/Users/mani/zephyrproject/zephyr/soc/sifive/sifive_freedom/Kconfig"
osource "/Users/mani/zephyrproject/zephyr/soc/sensry/Kconfig"
osource "/Users/mani/zephyrproject/zephyr/soc/rockchip/Kconfig"
osource "/Users/mani/zephyrproject/zephyr/soc/renode/riscv_virtual/Kconfig"
osource "/Users/mani/zephyrproject/zephyr/soc/renode/cortex_r8_virtual/Kconfig"
osource "/Users/mani/zephyrproject/zephyr/soc/renesas/smartbond/Kconfig"
osource "/Users/mani/zephyrproject/zephyr/soc/renesas/rz/Kconfig"
osource "/Users/mani/zephyrproject/zephyr/soc/renesas/rx/Kconfig"
osource "/Users/mani/zephyrproject/zephyr/soc/renesas/rcar/Kconfig"
osource "/Users/mani/zephyrproject/zephyr/soc/renesas/ra/Kconfig"
osource "/Users/mani/zephyrproject/zephyr/soc/realtek/fingerprint/Kconfig"
osource "/Users/mani/zephyrproject/zephyr/soc/realtek/ec/Kconfig"
osource "/Users/mani/zephyrproject/zephyr/soc/realtek/bee/Kconfig"
osource "/Users/mani/zephyrproject/zephyr/soc/realtek/ameba/Kconfig"
osource "/Users/mani/zephyrproject/zephyr/soc/raspberrypi/rpi_pico/Kconfig"
osource "/Users/mani/zephyrproject/zephyr/soc/quicklogic/eos_s3/Kconfig"
osource "/Users/mani/zephyrproject/zephyr/soc/qemu/virt_riscv/Kconfig"
osource "/Users/mani/zephyrproject/zephyr/soc/qemu/or1k/Kconfig"
osource "/Users/mani/zephyrproject/zephyr/soc/qemu/malta/Kconfig"
osource "/Users/mani/zephyrproject/zephyr/soc/openisa/rv32m1/Kconfig"
osource "/Users/mani/zephyrproject/zephyr/soc/openhwgroup/cva6/Kconfig"
osource "/Users/mani/zephyrproject/zephyr/soc/oct/osd32mp15x/Kconfig"
osource "/Users/mani/zephyrproject/zephyr/soc/nxp/s32/Kconfig"
osource "/Users/mani/zephyrproject/zephyr/soc/nxp/rw/Kconfig"
osource "/Users/mani/zephyrproject/zephyr/soc/nxp/mcx/Kconfig"
osource "/Users/mani/zephyrproject/zephyr/soc/nxp/lpc/Kconfig"
osource "/Users/mani/zephyrproject/zephyr/soc/nxp/layerscape/Kconfig"
osource "/Users/mani/zephyrproject/zephyr/soc/nxp/kinetis/Kconfig"
osource "/Users/mani/zephyrproject/zephyr/soc/nxp/imxrt/Kconfig"
osource "/Users/mani/zephyrproject/zephyr/soc/nxp/imx/Kconfig"
osource "/Users/mani/zephyrproject/zephyr/soc/nuvoton/numicro/Kconfig"
osource "/Users/mani/zephyrproject/zephyr/soc/nuvoton/numaker/Kconfig"
osource "/Users/mani/zephyrproject/zephyr/soc/nuvoton/npcx/Kconfig"
osource "/Users/mani/zephyrproject/zephyr/soc/nuvoton/npcm/Kconfig"
osource "/Users/mani/zephyrproject/zephyr/soc/nordic/Kconfig"
osource "/Users/mani/zephyrproject/zephyr/soc/neorv32/Kconfig"
osource "/Users/mani/zephyrproject/zephyr/soc/native/inf_clock/Kconfig"
osource "/Users/mani/zephyrproject/zephyr/soc/microchip/sam/sama7/Kconfig"
osource "/Users/mani/zephyrproject/zephyr/soc/microchip/sam/sam_d5x_e5x/Kconfig"
osource "/Users/mani/zephyrproject/zephyr/soc/microchip/pic64/Kconfig"
osource "/Users/mani/zephyrproject/zephyr/soc/microchip/pic32c/pic32cz_ca/Kconfig"
osource "/Users/mani/zephyrproject/zephyr/soc/microchip/pic32c/pic32cx_sg/Kconfig"
osource "/Users/mani/zephyrproject/zephyr/soc/microchip/pic32c/pic32cm_sg_gc/Kconfig"
osource "/Users/mani/zephyrproject/zephyr/soc/microchip/pic32c/pic32cm_pl/Kconfig"
osource "/Users/mani/zephyrproject/zephyr/soc/microchip/pic32c/pic32cm_jh/Kconfig"
osource "/Users/mani/zephyrproject/zephyr/soc/microchip/pic32c/pic32ck_sg_gc/Kconfig"
osource "/Users/mani/zephyrproject/zephyr/soc/microchip/miv/Kconfig"
osource "/Users/mani/zephyrproject/zephyr/soc/microchip/mec/Kconfig"
osource "/Users/mani/zephyrproject/zephyr/soc/mediatek/mt8xxx/Kconfig"
osource "/Users/mani/zephyrproject/zephyr/soc/lowrisc/opentitan/Kconfig"
osource "/Users/mani/zephyrproject/zephyr/soc/litex/Kconfig"
osource "/Users/mani/zephyrproject/zephyr/soc/ite/ec/Kconfig"
osource "/Users/mani/zephyrproject/zephyr/soc/intel/wildcat_lake/Kconfig"
osource "/Users/mani/zephyrproject/zephyr/soc/intel/raptor_lake/Kconfig"
osource "/Users/mani/zephyrproject/zephyr/soc/intel/panther_lake/Kconfig"
osource "/Users/mani/zephyrproject/zephyr/soc/intel/lakemont/Kconfig"
osource "/Users/mani/zephyrproject/zephyr/soc/intel/intel_socfpga_std/Kconfig"
osource "/Users/mani/zephyrproject/zephyr/soc/intel/intel_socfpga/Kconfig"
osource "/Users/mani/zephyrproject/zephyr/soc/intel/intel_niosv/Kconfig"
osource "/Users/mani/zephyrproject/zephyr/soc/intel/intel_ish/Kconfig"
osource "/Users/mani/zephyrproject/zephyr/soc/intel/intel_adsp/Kconfig"
osource "/Users/mani/zephyrproject/zephyr/soc/intel/elkhart_lake/Kconfig"
osource "/Users/mani/zephyrproject/zephyr/soc/intel/atom/Kconfig"
osource "/Users/mani/zephyrproject/zephyr/soc/intel/apollo_lake/Kconfig"
osource "/Users/mani/zephyrproject/zephyr/soc/intel/alder_lake/Kconfig"
osource "/Users/mani/zephyrproject/zephyr/soc/infineon/psoc4/Kconfig"
osource "/Users/mani/zephyrproject/zephyr/soc/infineon/edge/Kconfig"
osource "/Users/mani/zephyrproject/zephyr/soc/infineon/cat3/Kconfig"
osource "/Users/mani/zephyrproject/zephyr/soc/infineon/cat1c/Kconfig"
osource "/Users/mani/zephyrproject/zephyr/soc/infineon/cat1b/Kconfig"
osource "/Users/mani/zephyrproject/zephyr/soc/infineon/cat1a/Kconfig"
osource "/Users/mani/zephyrproject/zephyr/soc/gd/gd32/Kconfig"
osource "/Users/mani/zephyrproject/zephyr/soc/gaisler/leon3/Kconfig"
osource "/Users/mani/zephyrproject/zephyr/soc/gaisler/gr716a/Kconfig"
osource "/Users/mani/zephyrproject/zephyr/soc/focaltech/Kconfig"
osource "/Users/mani/zephyrproject/zephyr/soc/espressif/Kconfig"
osource "/Users/mani/zephyrproject/zephyr/soc/ene/kb1200/Kconfig"
osource "/Users/mani/zephyrproject/zephyr/soc/ene/kb106x/Kconfig"
osource "/Users/mani/zephyrproject/zephyr/soc/elan/em32f967/Kconfig"
osource "/Users/mani/zephyrproject/zephyr/soc/egis/Kconfig"
osource "/Users/mani/zephyrproject/zephyr/soc/efinix/sapphire/Kconfig"
osource "/Users/mani/zephyrproject/zephyr/soc/cdns/xtensa_sample_controller/Kconfig"
osource "/Users/mani/zephyrproject/zephyr/soc/cdns/swerv/Kconfig"
osource "/Users/mani/zephyrproject/zephyr/soc/cdns/sample_controller32/Kconfig"
osource "/Users/mani/zephyrproject/zephyr/soc/cdns/dc233c/Kconfig"
osource "/Users/mani/zephyrproject/zephyr/soc/brcm/bcmvk/Kconfig"
osource "/Users/mani/zephyrproject/zephyr/soc/brcm/bcm2712/Kconfig"
osource "/Users/mani/zephyrproject/zephyr/soc/brcm/bcm2711/Kconfig"
osource "/Users/mani/zephyrproject/zephyr/soc/blackberry/qnxhv_vm/Kconfig"
osource "/Users/mani/zephyrproject/zephyr/soc/bflb/Kconfig"
osource "/Users/mani/zephyrproject/zephyr/soc/atmel/sam0/Kconfig"
osource "/Users/mani/zephyrproject/zephyr/soc/atmel/sam/Kconfig"
osource "/Users/mani/zephyrproject/zephyr/soc/aspeed/Kconfig"
osource "/Users/mani/zephyrproject/zephyr/soc/arm/Kconfig"
osource "/Users/mani/zephyrproject/zephyr/soc/arm/beetle/Kconfig"
osource "/Users/mani/zephyrproject/zephyr/soc/antmicro/myra/Kconfig"
osource "/Users/mani/zephyrproject/zephyr/soc/andestech/Kconfig"
osource "/Users/mani/zephyrproject/zephyr/soc/amd/acp_7_x/Kconfig"
osource "/Users/mani/zephyrproject/zephyr/soc/amd/acp_7_0/Kconfig"
osource "/Users/mani/zephyrproject/zephyr/soc/amd/acp_6_0/Kconfig"
osource "/Users/mani/zephyrproject/zephyr/soc/ambiq/Kconfig"
osource "/Users/mani/zephyrproject/zephyr/soc/allwinner/sun8i_h3/Kconfig"
osource "/Users/mani/zephyrproject/zephyr/soc/allwinner/sun50i_h618/Kconfig"
osource "/Users/mani/zephyrproject/zephyr/soc/alif/ensemble/Kconfig"
osource "/Users/mani/zephyrproject/zephyr/soc/alif/balletto/Kconfig"
osource "/Users/mani/zephyrproject/zephyr/soc/aesc/Kconfig"
osource "/Users/mani/zephyrproject/zephyr/soc/adi/max32/Kconfig"
```
