#include <stdio.h>
#include "freertos/FreeRTOS.h"
#include "freertos/task.h"
#include "driver/i2s_std.h"

#define EXAMPLE_STD_BCLK_IO1       5     // I2S bit clock io number
#define EXAMPLE_STD_WS_IO1         4      // I2S word select io number
#define EXAMPLE_STD_DOUT_IO1       7    // I2S data out io number
#define EXAMPLE_STD_DIN_IO1        6     // I2S data in io number



#define AUDIO_SAMPLES_PER_BLOCK 512
#define AUDIO_BLOCK_COUNT 4

#define BUFF_SIZE          2048  // Audio_samples_per_block * sizeof(int16_t) * AUDIO_BLOCK_COUNT


typedef struct {
    int16_t samples[AUDIO_SAMPLES_PER_BLOCK];  // 160 samples of 16-bit audio data
    size_t samples_count;
} audio_block_t;

static audio_block_t pool[AUDIO_BLOCK_COUNT];  // Pool of audio blocks

static QueueHandle_t filled_queue;
static QueueHandle_t free_queue;


static i2s_chan_handle_t                tx_chan;        // I2S tx channel handler
static i2s_chan_handle_t                rx_chan;       // I2S rx channel handler

static void i2s_example_init_std_duplex(void)
{
    /* Setp 1: Determine the I2S channel configuration and allocate both channels
     * The default configuration can be generated by the helper macro,
     * it only requires the I2S controller id and I2S role */
    i2s_chan_config_t chan_cfg = I2S_CHANNEL_DEFAULT_CONFIG(I2S_NUM_AUTO, I2S_ROLE_MASTER);
    ESP_ERROR_CHECK(i2s_new_channel(&chan_cfg, &tx_chan, &rx_chan));

    /* Step 2: Setting the configurations of standard mode, and initialize rx & tx channels
     * The slot configuration and clock configuration can be generated by the macros
     * These two helper macros is defined in 'i2s_std.h' which can only be used in STD mode.
     * They can help to specify the slot and clock configurations for initialization or re-configuring */
    i2s_std_config_t std_cfg = {
        .clk_cfg  = I2S_STD_CLK_DEFAULT_CONFIG(16000),
        .slot_cfg = I2S_STD_MSB_SLOT_DEFAULT_CONFIG(I2S_DATA_BIT_WIDTH_32BIT, I2S_SLOT_MODE_MONO),
        .gpio_cfg = {
            .mclk = I2S_GPIO_UNUSED,    // some codecs may require mclk signal, this example doesn't need it
            .bclk = EXAMPLE_STD_BCLK_IO1,
            .ws   = EXAMPLE_STD_WS_IO1,
            .dout = EXAMPLE_STD_DOUT_IO1,
            .din  = EXAMPLE_STD_DIN_IO1, // In duplex mode, bind output and input to a same gpio can loopback internally
            .invert_flags = {
                .mclk_inv = false,
                .bclk_inv = false,
                .ws_inv   = false,
            },
        },
    };
    /* Initialize the channels */
    ESP_ERROR_CHECK(i2s_channel_init_std_mode(tx_chan, &std_cfg));
    ESP_ERROR_CHECK(i2s_channel_init_std_mode(rx_chan, &std_cfg));



}

static void i2s_example_read_task(void *args)
{
    // int32_t *r_buf = (int32_t *)calloc(1, EXAMPLE_BUFF_SIZE);
    // printf("Buffer allocated at %p\n", r_buf);
    // printf("Buffer size: %d bytes\n", EXAMPLE_BUFF_SIZE);
    static int32_t mic_raw[AUDIO_SAMPLES_PER_BLOCK];

    size_t bytes_read = 0;
    audio_block_t *free_block;

    while (1) {
        
        xQueueReceive(free_queue, &free_block, portMAX_DELAY);
        /* Read i2s data */
        esp_err_t ret = i2s_channel_read(rx_chan,mic_raw, sizeof(mic_raw), &bytes_read, 2000);

        int count = bytes_read / sizeof(int32_t);

        int j = 0;

        for(int i=0;i<count;i+=2)
        {
            free_block->samples[j++] =
                (int16_t)(mic_raw[i] >> 16);
        }

        free_block->samples_count = j;

        xQueueSend(filled_queue, &free_block, portMAX_DELAY);

        if (ret == ESP_OK) {
            printf("Read Task: read %d bytes\n", bytes_read);
        } else {
            printf("Read Task: i2s read failed\n");
        }
    }
    vTaskDelete(NULL);
}

static void i2s_example_write_task(void *args)
{
    static int32_t spk_raw[AUDIO_SAMPLES_PER_BLOCK];
    size_t written_bytes = 0;
    audio_block_t *filled_block;

    while (1) {
        xQueueReceive(filled_queue, &filled_block, portMAX_DELAY);

         // Expand int16_t back to int32_t for 32-bit I2S DMA
        for (int i = 0; i < filled_block->samples_count; i++) {
            spk_raw[i] = (int32_t)filled_block->samples[i] << 16;
        }

        /* Write i2s data */
        esp_err_t ret = i2s_channel_write(tx_chan, spk_raw, filled_block->samples_count * sizeof(int32_t), &written_bytes, 2000);
        
        xQueueSend(free_queue, &filled_block, portMAX_DELAY);
        
        if (ret == ESP_OK) {
            printf("Write Task: i2s write %d bytes\n", written_bytes);
        } else {
            printf("Write Task: i2s write failed\n");
        }
    }    
    vTaskDelete(NULL);
}

void app_main(void)
{
    vTaskDelay(pdMS_TO_TICKS(1000));
    printf("APP START\n");

    //Initialising the queues for the audio blocks
    filled_queue = xQueueCreate(AUDIO_BLOCK_COUNT, sizeof(audio_block_t *));
    free_queue = xQueueCreate(AUDIO_BLOCK_COUNT, sizeof(audio_block_t *));

    for(int i = 0; i < AUDIO_BLOCK_COUNT; i++){
        audio_block_t *free_block = &pool[i];
        xQueueSend(free_queue, &free_block, portMAX_DELAY);
    }

    i2s_example_init_std_duplex();

    // Enable both RX and TX both channels this was the main issue
    ESP_ERROR_CHECK(i2s_channel_enable(rx_chan));
    printf("RX channel enabled\n");
    ESP_ERROR_CHECK(i2s_channel_enable(tx_chan));
    printf("TX channel enabled\n");
   

    xTaskCreate(i2s_example_read_task, "i2s_example_read_task", 4096+2048, NULL, 5, NULL);
    xTaskCreate(i2s_example_write_task, "i2s_example_write_task", 4096, NULL, 5, NULL);


    vTaskDelay(pdMS_TO_TICKS(1000));
    printf("APP END\n");

}